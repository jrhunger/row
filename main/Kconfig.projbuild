## main/Kconfig.projbuild
```kconfig
menu "Rower Configuration"

    orsource "$IDF_PATH/examples/common_components/env_caps/$IDF_TARGET/Kconfig.env_caps"

    config GPIO_REED
        int "GPIO input pin 0"
        range ENV_GPIO_RANGE_MIN ENV_GPIO_IN_RANGE_MAX
        default 8
        help
            GPIO pin number to be used as rotation sensor reed input


endmenu
```
